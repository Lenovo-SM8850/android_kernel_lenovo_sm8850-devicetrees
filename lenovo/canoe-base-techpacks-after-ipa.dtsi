// SPDX-License-Identifier: GPL-2.0-only
// Dsp/canoe/canoe-dsp_v2.dts
#include "../qcom/dsp/canoe/canoe-dsp_v2.dtsi"
// Graphics/gpu/canoe-v2-gpu.dts
#include <dt-bindings/clock/qcom,aop-qmp.h>
#include <dt-bindings/clock/qcom,gcc-canoe.h>
#include <dt-bindings/clock/qcom,gpucc-canoe.h>
#include <dt-bindings/clock/qcom,gxclkctl-canoe.h>
#include <dt-bindings/clock/qcom,rpmh.h>
#include <dt-bindings/interconnect/qcom,canoe.h>
#include <dt-bindings/interrupt-controller/arm-gic.h>
#include <dt-bindings/regulator/qcom,rpmh-regulator-levels.h>
#include <dt-bindings/interrupt-controller/arm-gic.h>
#include "../qcom/graphics/gpu/canoe-v2-gpu.dtsi"
#include "../qcom/graphics/gpu/canoe-v2-gpu-pwrlevels.dtsi"
// Eva/canoe-eva.dts
#include <dt-bindings/interrupt-controller/arm-gic.h>
#include <dt-bindings/soc/qcom,ipcc.h>
#include <dt-bindings/interconnect/qcom,canoe.h>
#include <dt-bindings/clock/qcom,videocc-canoe.h>
#include <dt-bindings/clock/qcom,gcc-canoe.h>
#include <dt-bindings/clock/qcom,evacc-canoe.h>
#include <dt-bindings/arm/msm/qti-smmu-proxy-dt-ids.h>
#include "../qcom/eva/canoe-eva.dtsi"
// Mmrm/canoe/canoe-mmrm.dts
#include <dt-bindings/clock/qcom,camcc-canoe.h>
#include <dt-bindings/clock/qcom,videocc-canoe.h>
#include <dt-bindings/clock/qcom,evacc-canoe.h>
#include <dt-bindings/clock/qcom,dispcc-canoe.h>
#include "../qcom/mmrm/canoe/canoe-mmrm.dtsi"
// Mm/hw_fence/canoe-hw-fence.dts
#include "../qcom/mm/hw_fence/canoe-hw-fence.dtsi"
// Mm/hfi_core/canoe-hfi-core.dts
#include "../qcom/mm/hfi_core/canoe-hfi-core.dtsi"
// Synx/synx/canoe-synx.dts
#include <dt-bindings/mailbox/qcom-ipcc.h>
#include <dt-bindings/mailbox/qcom-ipcc-canoe.h>
#include <dt-bindings/interrupt-controller/arm-gic.h>
#include "../qcom/synx/synx/canoe-synx.dtsi"
// Video/canoe-vidc-v2.dts
#include <dt-bindings/interrupt-controller/arm-gic.h>
#include <dt-bindings/clock/qcom,gcc-canoe.h>
#include <dt-bindings/interconnect/qcom,canoe.h>
#include <dt-bindings/clock/qcom,videocc-canoe.h>
#include "../qcom/video/canoe-vidc-v2.dtsi"
